## boards/shields/joy_board/Kconfig.defconfig
```kconfig
if SHIELD_JOY_BOARD_LEFT

# Name must be less than 16 characters long!
config ZMK_KEYBOARD_NAME
    default "Joy Board"

config ZMK_SPLIT_ROLE_CENTRAL
    default y

endif

if SHIELD_JOY_BOARD_LEFT || SHIELD_MY_KEYBOARD_RIGHT

config ZMK_SPLIT
    default y

endif
```

## boards/shields/joy_board/Kconfig.shield
```kconfig
# No whitespace after the comma or in your part name!
config SHIELD_JOY_BOARD_LEFT
    def_bool $(shields_list_contains,joy_board_left)

# No whitespace after the comma or in your part name!
config SHIELD_JOY_BOARD_RIGHT
    def_bool $(shields_list_contains,joy_board_right)
```
